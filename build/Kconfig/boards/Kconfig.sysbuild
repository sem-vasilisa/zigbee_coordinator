## build/Kconfig/boards/Kconfig.sysbuild
```kconfig
# Load Sysbuild board Kconfig descriptions.
osource "/home/goodbyte/projects/workspace_zigbee/zephyr/boards/nordic/nrf52840dongle/Kconfig.sysbuild"
```

## build/zigbee-coordinator/Kconfig/Kconfig.shield
```kconfig
osource "/home/goodbyte/projects/workspace_zigbee/nrf/boards/shields/*/Kconfig.shield"
```

## build/zigbee-coordinator/Kconfig/boards/Kconfig
```kconfig
# Load Zephyr board Kconfig descriptions.
osource "/home/goodbyte/projects/workspace_zigbee/zephyr/boards/nordic/nrf52840dongle/Kconfig"
```

## build/zigbee-coordinator/Kconfig/boards/Kconfig.defconfig
```kconfig
# Load Zephyr board defconfig descriptions.
osource "/home/goodbyte/projects/workspace_zigbee/zephyr/boards/nordic/nrf52840dongle/Kconfig.defconfig"
```
